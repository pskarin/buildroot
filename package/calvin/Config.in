## package/calvin/Config.in
```kconfig
config BR2_PACKAGE_CALVIN
	bool "calvin"
	select BR2_PACKAGE_PYTHON_REQUESTS
	select BR2_PACKAGE_PYTHON_TWISTED
	select BR2_PACKAGE_PYTHON_COLORLOG
	select BR2_PACKAGE_PYTHON_INFITRACEBACK
	select BR2_PACKAGE_PYTHON_INFIPYUTILS
	select BR2_PACKAGE_PYTHON_KADEMLIA
	select BR2_PACKAGE_PYTHON_MOCK
	select BR2_PACKAGE_PYTHON_PLY
	select BR2_PACKAGE_PYTHON_PYTEST
	select BR2_PACKAGE_PYTHON_WRAPT
	select BR2_PACKAGE_PYTHON_NOSE
	select BR2_PACKAGE_PYTHON_EMPORT
	select BR2_PACKAGE_PYTHON_RPCUDP
	select BR2_PACKAGE_PYTHON_SIX
	select BR2_PACKAGE_PYTHON_UMSGPACK
	select BR2_PACKAGE_PYTHON_PY
	select BR2_PACKAGE_PYTHON_SERIAL
	select BR2_PACKAGE_CA_CERTIFICATES
	help
	  Calvin distributed execution environment

if BR2_PACKAGE_CALVIN
config BR2_PACKAGE_CALVIN_DEV
        select BR2_PACKAGE_GIT
	select BR2_PACKAGE_LIBCURL
	select BR2_PACKAGE_CURL
	select BR2_PACKAGE_OPENSSL
        bool "Development"
endif
```

## package/python-calvin/Config.in
```kconfig
config BR2_PACKAGE_PYTHON_CALVIN
	bool "python-calvin"
	select BR2_PACKATE_PYTHON_REQUESTS
	select BR2_PACKATE_PYTHON_TWISTED
	select BR2_PACKATE_PYTHON_COLORLOG
	select BR2_PACKATE_PYTHON_INFITRACEBACK
	select BR2_PACKATE_PYTHON_KADEMLIA
	select BR2_PACKATE_PYTHON_MOCK
	select BR2_PACKATE_PYTHON_PLY
	select BR2_PACKATE_PYTHON_PYTEST
	select BR2_PACKATE_PYTHON_WRAPT
	help
	  Calvin distributed execution environment
```

## package/python-colorlog/Config.in
```kconfig
config BR2_PACKAGE_PYTHON_COLORLOG
	bool "python-colorlog"
	help
	  It allows colors to be placed in the format string, which is mostly useful
	  when paired with a StreamHandler that is outputting to a terminal. This is
	  accomplished by added a set of terminal color codes to the record before
	  it is used to format the string.
```

## package/python-cryptography/Config.in
```kconfig
config BR2_PACKAGE_PYTHON_CRYPTOGRAPHY
	bool "python-cryptogaphy"
	help
	  I think you meant "cryptography"
```

## package/python-emport/Config.in
```kconfig
config BR2_PACKAGE_PYTHON_EMPORT
	bool "python-emport"
	help
	  mport is a small utility library for importing files by file name. It
	  exposed a single function, import_file(filename).
```

## package/python-infiexceptools/Config.in
```kconfig
config BR2_PACKAGE_PYTHON_INFIEXCEPTOOLS
	bool "python-infiexceptools"
	help
	  a mechanism for chaining exceptions, compatible with Python 2.x
```

## package/python-infipyutils/Config.in
```kconfig
config BR2_PACKAGE_PYTHON_INFIPYUTILS
	bool "python-infipyutils"
	help
	  Misc. pure-python utilities
```

## package/python-infitraceback/Config.in
```kconfig
config BR2_PACKAGE_PYTHON_INFITRACEBACK
	bool "python-infitraceback"
	help
	  better tracebacks
```

## package/python-kademlia/Config.in
```kconfig
config BR2_PACKAGE_PYTHON_KADEMLIA
	bool "python-kademlia"
	help
	  Kademlia is a distributed hash table for decentralized peer-to-peer
	  computer networks.
```

## package/python-openssl/Config.in
```kconfig
config BR2_PACKAGE_PYTHON_OPENSSL
	bool "python-openssl"
	select BR2_PACKAGE_LIBFFI
	help
	  Python wrapper module around the OpenSSL library
```

## package/python-passlib/Config.in
```kconfig
config BR2_PACKAGE_PYTHON_PASSLIB
	bool "python-passlib"
	help
	  Comprehensive password hashing framework supporting over 30 schemes
```

## package/python-pyjwt/Config.in
```kconfig
config BR2_PACKAGE_PYTHON_PYJWT
	bool "python-pyjwt"
	help
	  JSON Web Token implementation in Python
```

## package/python-pytest/Config.in
```kconfig
config BR2_PACKAGE_PYTHON_PYTEST
	bool "python-pytest"
	help
	  The pytest testing tool makes it easy to write small tests, yet scales to support complex functional testing. It provides

	    auto-discovery of test modules and functions,
	    detailed info on failing assert statements (no need to remember self.assert* names)
	    modular fixtures for managing small or parametrized long-lived test resources.
	    multi-paradigm support: you can use pytest to run test suites based on unittest (or trial), nose
	    single-source compatibility from Python2.6 all the way up to Python3.4, PyPy-2.3, (jython-2.5 untested)
	    many external plugins.

	  http://pytest.org
```

## package/python-service-identity/Config.in
```kconfig
config BR2_PACKAGE_PYTHON_SERVICE_IDENTITY
	bool "python-service-identity"
	help
	  Service identity verification for pyOpenSSL.
```

## package/python-umsgpack/Config.in
```kconfig
config BR2_PACKAGE_PYTHON_UMSGPACK
	bool "python-umsgpack"
	help
	  A portable, lightweight MessagePack serializer and deserializer written in pure Python.
```

## package/python-wrapt/Config.in
```kconfig
config BR2_PACKAGE_PYTHON_WRAPT
	bool "python-wrapt"
	help
	  A Python module for decorators, wrappers and monkey patching.
```
